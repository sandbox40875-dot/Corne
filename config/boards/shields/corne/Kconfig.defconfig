## config/boards/shields/corne/Kconfig.defconfig
```kconfig
# =====================================================
# Corne Split Configuration
# =====================================================

if SHIELD_CORNE_LEFT

# Left side acts as the BLE central (connects to computer)
config ZMK_SPLIT_ROLE_CENTRAL
    default y

endif


if SHIELD_CORNE_RIGHT

# Right side acts as peripheral (connects to left half)
config ZMK_SPLIT_ROLE_PERIPHERAL
    default y

endif


if SHIELD_CORNE_LEFT || SHIELD_CORNE_RIGHT

# Enable split keyboard
config ZMK_SPLIT
    default y

# Bluetooth device name (advertised name)
config BT_DEVICE_NAME
    default "MK42Keyboard"

# Allow multiple paired devices
config BT_MAX_PAIRED
    default 5

# Improve Windows BLE compatibility
config ZMK_BLE_PASSKEY_ENTRY
    default n

endif
```

## config/west.yml
```yaml
manifest:
  remotes:
    - name: zmkfirmware
      url-base: https://github.com/zmkfirmware
    - name: gohanda
      url-base: https://github.com/gohanda11

  projects:
    - name: zmk
      remote: zmkfirmware
      revision: v0.2
      import: app/west.yml

    # ADD THIS BLOCK
    - name: zmk-ws2812-driver
      remote: gohanda
      revision: main
      path: modules/zmk-ws2812-driver

  self:
    path: config
```
