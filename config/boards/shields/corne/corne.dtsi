#include <dt-bindings/zmk/matrix_transform.h>

/ {
    matrix {
        compatible = "zmk,matrix-gpio";

        /* LEFT HALF – ROWS ONLY */
        row-gpios = <
            &gpio1 11 (GPIO_ACTIVE_HIGH | GPIO_PULL_DOWN)  /* Row 0 */
            &gpio1 13 (GPIO_ACTIVE_HIGH | GPIO_PULL_DOWN)  /* Row 1 */
            &gpio1 15 (GPIO_ACTIVE_HIGH | GPIO_PULL_DOWN)  /* Row 2 */
            &gpio1 6  (GPIO_ACTIVE_HIGH | GPIO_PULL_DOWN)  /* Row 3 (thumbs) */
        >;

        /* Explicit polarity */
        row-gpio-active-level = <GPIO_ACTIVE_HIGH>;
        col-gpio-active-level = <GPIO_ACTIVE_HIGH>;
    };
};


&i2c0 {
    status = "okay";

    oled: ssd1306@3c {
        compatible = "solomon,ssd1306fb";
        reg = <0x3c>;

        width = <128>;
        height = <32>;

        segment-offset = <0>;
        page-offset = <0>;
        display-offset = <0>;
        multiplex-ratio = <31>;
        prechargep = <0x22>;
    };
};


